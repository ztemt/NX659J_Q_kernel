qcom,atl_4420_10a  {
	qcom,profile-revision = <24>;
	/* #4328160_ZTE_NX659J_4500mAh_averaged_MasterSlave_Dec4th2019*/
	qcom,max-voltage-uv = <4450000>;
	qcom,fastchg-current-ma = <10000>;
	qcom,jeita-fcc-ranges = <0  100  1300000
				101 150  4400000
				151 450  10000000
				451 550  2000000>;
	qcom,jeita-fv-ranges = <0   100  4450000
				101 150  4450000
				151 450  4450000
				451 550  4450000>;

	qcom,ocv-based-step-chg;
	qcom,step-chg-ranges = <3400000  4250000  10000000
				4250001  4350000  6000000
				4350001  4450000  4400000>;
	qcom,fg-cc-cv-threshold-mv = <4430>;
	qcom,nom-batt-capacity-mah = <4500>;
	qcom,batt-id-kohm = <15>;
	qcom,battery-beta = <4250>;
	qcom,therm-room-temp = <100000>;

	qcom,battery-type = "atl_4420_10a";
	qcom,therm-coefficients = <0x2318 0xd0c 0xdaf7 0xc556 0x848d>;
	qcom,therm-center-offset = <0x70>;
	qcom,therm-pull-up = <100>;
	qcom,rslow-normal-coeffs = <0xea 0x0c 0x5a 0x0a>;
	qcom,rslow-low-coeffs = <0x21 0x0c 0x32 0x03>;
	qcom,checksum = <0x8FA4>;
	qcom,gui-version = "PM855GUI - 1.0.0.13";
	qcom,fg-profile-data = [
		 09 00 CC E2
		 CA E5 DE E3
		 F5 E5 00 00
		 E1 BD 5C 8A
		 F9 87 26 A2
		 26 9D E9 87
		 1C 00 EA 0C
		 5A 0A 6E 05
		 07 02 CE 07
		 32 00 21 EA
		 13 E4 0B E3
		 A7 0B B2 EB
		 F0 B2 14 1B
		 F6 F5 AA E5
		 60 00 3E 00
		 42 00 40 00
		 2E 00 2F 00
		 3A 00 41 00
		 40 00 46 00
		 3C 00 60 00
		 42 00 42 00
		 5E 00 53 00
		 48 00 99 00
		 69 64 58 00
		 59 00 5D 08
		 60 00 52 00
		 64 00 86 10
		 70 10 60 00
		 B1 28 7E 48
		 67 58 60 0E
		 5E 00 D8 00
		 5C 20 3E 0C
		 DE 03 D4 04
		 47 1C B5 0B
		 63 0D E8 22
		 47 17 30 42
		 B3 55 5E 03
		 69 13 89 20
		 39 0C E5 13
		 BC 0C DD 1C
		 F3 F9 EF 05
		 81 FA 95 17
		 60 23 52 45
		 ED 52 7B 14
		 A6 24 28 E4
		 29 CB 63 CD
		 F4 1C 87 AA
		 BE 06 E7 B3
		 3C 17 84 83
		 40 85 EF 92
		 A5 A0 09 80
		 5B 02 0B ED
		 0B EB 4B E4
		 00 00 90 D4
		 E7 E2 FE FF
		 A4 DC DB AD
		 AA 18 1A 00
		 5B DD AC 02
		 DB 05 19 04
		 CE 07 32 00
		 7B 01 A6 03
		 69 04 55 03
		 35 02 56 02
		 98 02 72 01
		 37 05 46 00
		 3B 00 48 00
		 4A 64 4C 00
		 50 08 4A 10
		 4C 00 49 00
		 4C 00 3F 10
		 3A 10 3B 00
		 52 20 53 40
		 5F 58 69 0F
		 49 00 53 00
		 5A 08 5D 00
		 45 00 42 00
		 3B 10 4D 10
		 46 00 5B 20
		 6C 40 43 50
		 54 10 51 00
		 48 10 32 10
		 D8 08 75 21
		 D8 FD 09 02
		 AD 04 C3 1C
		 63 23 D3 45
		 3E 52 63 18
		 B7 03 3C 04
		 AA 02 75 12
		 3F 0A 98 20
		 55 04 D0 03
		 C9 04 C4 1C
		 1A 03 EA 05
		 57 02 7C 18
		 4F 03 F3 04
		 EA 03 6C 00
		 A8 25 CC 05
		 9C 03 EF 04
		 FB 1C 63 03
		 75 05 01 03
		 60 18 2E 03
		 43 05 3E 03
		 9E 00 AD 00
		 C0 00 FA 00
		 BF 11 00 00
	];
};
