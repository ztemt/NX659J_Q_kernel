## drivers/fan/Kconfig
```kconfig
#
# Fan driver configuration
#
menuconfig FAN
	bool "Fan"
	default n
	help
	  Say Y here if you have a Fan connected
	  to your system.

	  If unsure, say N.

if FAN

config FAN_CORE
	bool "Fan core"
	default n
#config FAN_UPDATA
#	bool "Fan updata"
#	default n

endif
```

## drivers/input/keyboard/cy8c4014l_touchkey_left/Kconfig
```kconfig
config NUBIA_CYPRESS_KEYBOARD_LEFT_GAMEFIRE
        tristate "Keypad NUBIA GameFire"
        depends on KEYBOARD_GPIO
	default y
        help
          Addr GameSwitchkey attr
```

## drivers/leds/nubia_led/Kconfig
```kconfig
#
# nubia led driver configuration
#

menuconfig NUBIA_LED
	tristate "nubia led driver"
	default n
	help
	  Say Y here if you have a nubia led connected
	  to your system.

	  If unsure, say N.

if NUBIA_LED
source "drivers/leds/nubia_led/aw9106_led0/Kconfig"
source "drivers/leds/nubia_led/aw9106_led1/Kconfig"
source "drivers/leds/nubia_led/aw22xxx/Kconfig"
source "drivers/leds/nubia_led/aw8695/Kconfig"
endif
```

## drivers/leds/nubia_led/aw22xxx/Kconfig
```kconfig
#
# nubia led aw9106 driver configuration
#

config NUBIA_LED_AW22XXX
	bool "nubia led aw22xxx driver"
	default n
	help
	  Say Y here if you have a nubia led aw22xxx connected
	  to your system.

	  If unsure, say N.
```

## drivers/leds/nubia_led/aw8695/Kconfig
```kconfig
#
# nubia led AW8695 driver configuration
#
config AW8695_HAPTIC
    tristate "Haptic driver for awinic AW8695 series"
    depends on I2C
    default y
    help
      This option enables support for AW8695 series Haptic Driver.
```

## drivers/leds/nubia_led/aw9106_led0/Kconfig
```kconfig
#
# nubia led aw9106 driver configuration
#

config NUBIA_LED0_AW9106
	bool "nubia led0 aw9106 driver"
	default n
	help
	  Say Y here if you have a nubia led aw9106 connected
	  to your system.

	  If unsure, say N.
```

## drivers/leds/nubia_led/aw9106_led1/Kconfig
```kconfig
#
# nubia led aw9106 driver configuration
#

config NUBIA_LED1_AW9106
	bool "nubia led1 aw9106 driver"
	default n
	help
	  Say Y here if you have a nubia led aw9106 connected
	  to your system.

	  If unsure, say N.
```

## drivers/nubia/Kconfig
```kconfig
#
# Nubia drivers configuration
#

#menuconfig NUBIA_DRIVERS
menu "nubia drivers"

config NUBIA_DRIVERS
	bool "NUBIA DRIVERS"
	default y
	help
	  Say Y here if you want to enable NUBIA DRIVERS
	  If unsure, say N.

comment "Nubia Device Drivers"

if NUBIA_DRIVERS

config NUBIA_FINGERPRINT
	bool "NUBIA_FINGERPRINT"
	default y
	help
	 Say Y here if you have enable NUBIA_FINGERPRINT
	 IF  unsure ,say N

config NUBIA_TOUCH
	bool "NUBIA_TOUCH"
	default n
	help
	 Say Y here if you have enable NUBIA_FINGERPRINT
	 IF  unsure ,say N

config NUBIA_SENSORS
        bool "NUBIA_SENSORS"
        default n
        help
         Say Y here if you have enable NUBIA_SENSORS
         IF  unsure ,say N

config NUBIA_DP
        bool "NUBIA_DP"
        default n
        help
         Say Y here if you have enable NUBIA_DP
         IF  unsure ,say N
endif


if NUBIA_TOUCH
source "drivers/nubia/touch/Kconfig"
endif

if NUBIA_SENSORS
source "drivers/nubia/sensors/Kconfig"
endif

if NUBIA_FINGERPRINT
source "drivers/nubia/fingerprint/Kconfig"
endif

if NUBIA_DP
source "drivers/nubia/dp/Kconfig"
endif

endmenu
```

## drivers/nubia/dp/Kconfig
```kconfig
#
# ZTE SoC drivers
#

config NUBIA_USB_DP_MODULES
	bool "NUBIA USB DP MODULES"
	default y
	help
	  usb switch to dp function
```

## drivers/nubia/fingerprint/Kconfig
```kconfig
################################################# FINGER_PRINTER START
config  NUBIA_SENSORS_FP
	tristate "NUBIA FP DEVICE"
	default y

if NUBIA_SENSORS_FP

source drivers/nubia/fingerprint/goodix/Kconfig

endif
```

## drivers/nubia/sensors/Kconfig
```kconfig
################################################# SENROS LOG

config FEATURE_NUBIA_SENSORS_LOG_ON
	tristate "NUBIA SENSORS LOG ON"
	depends on NUBIA_SENSORS
	default n
	help
		If you want to enable the sensor log,

################################################# STK3332_PROXIMITY_AND_LIGHT
config NUBIA_SENSORS_STK3337
	tristate "support proximity/light driver"
	depends on NUBIA_SENSORS
	default n
	help
		nubia device of ambient&&prox
```

## drivers/nubia/touch/Kconfig
```kconfig
config TOUCHSCREEN_SYNAPTICS_DSX
        tristate "NUBIA SYNAPTICS DEVICE"
        default n
if TOUCHSCREEN_SYNAPTICS_DSX
source "drivers/nubia/touch/synaptics_dsx/Kconfig"


config TOUCHSCREEN_NUBIA_SYNAPTICS_DSX
        bool "config nubia synaptics dsx"
        default n
        help
          Say Y here if you have a nubia touchscreen hxchipset connected
          to your system.
	  If unsure, say N.

endif	  
```

## drivers/power/Kconfig
```kconfig
source "drivers/power/avs/Kconfig"
source "drivers/power/reset/Kconfig"
source "drivers/power/supply/Kconfig"
#Begin [0016004715 add the kernel power code,20180316]
source "drivers/power/ztemt_power_debug/Kconfig"
#End   [0016004715 add the kernel power code,20180316]
```

## drivers/power/supply/pca9468/Kconfig
```kconfig
config NUBIA_NXP_CHARGER
	tristate "TI pca9468 battery charger driver"
	default y
	help
	  Say Y to enable support for TI pca9468 charger
config USBPD_PHY_QCOM
	tristate "TI pca9468 battery charger driver"
	default y
	help
	  Say Y to enable support for TI pca9468 charger
	  
```

## drivers/power/ztemt_power_debug/Kconfig
```kconfig
config ZTEMT_POWER_DEBUG
	bool "ZTEMT Power Debug Feature"
	default n
	help
	  ZTEMT Power Debug Feature
```

## kernel/Kconfig.freezer
```kconfig
config FREEZER
	def_bool PM_SLEEP || CGROUP_FREEZER

config CPU_PRESSURE_MONITOR
        bool "cpu pressure monitor"
        help
          Provides a way to monitor cpu pressure
        default y
```
