
qcom,atl_4420_8a {
	qcom,profile-revision = <24>;
	/* #4256542_ZTE_NX659J_4550mAh_averaged_MasterSlave_Oct22nd2019*/
	qcom,max-voltage-uv = <4450000>;
	qcom,fastchg-current-ma = <10000>;
	qcom,jeita-fcc-ranges = <0  100  1300000
				101 150  4400000
				151 450  10000000
				451 550  2000000>;
	qcom,jeita-fv-ranges = <0   100  4450000
				101 150  4450000
				151 450  4450000
				451 550  4450000>;

	qcom,ocv-based-step-chg;
	qcom,step-chg-ranges = <3400000  4250000  10000000
				4250001  4350000  6000000
				4350001  4450000  4400000>;
	
	qcom,fg-cc-cv-threshold-mv = <4420>;
	qcom,nom-batt-capacity-mah = <4550>;
	qcom,batt-id-kohm = <15>;
	qcom,battery-beta = <4250>;
	qcom,therm-room-temp = <100000>;

	qcom,battery-type = "atl_4420_8a";
	qcom,therm-coefficients = <0x2318 0xd0c 0xdaf7 0xc556 0x848d>;
	qcom,therm-center-offset = <0x70>;
	qcom,therm-pull-up = <100>;
	qcom,rslow-normal-coeffs = <0x90 0x15 0x08 0x12>;
	qcom,rslow-low-coeffs = <0x9f 0x1d 0x69 0x06>;
	qcom,checksum = <0x23E7>;
	qcom,gui-version = "PM855GUI - 1.0.0.13";
	qcom,fg-profile-data = [
		 09 00 FD E2
		 38 E5 51 00
		 39 E5 00 00
		 C2 BD 12 8A
		 FD 87 E5 9A
		 EC 9D FE 87
		 18 00 90 15
		 08 12 EE 05
		 40 01 CE 07
		 32 00 BE EA
		 A2 ED 9B D3
		 80 12 B3 EA
		 96 C5 A3 13
		 2B 02 0A CB
		 60 00 4C 00
		 50 00 50 00
		 36 00 2F 00
		 38 00 41 00
		 3E 00 43 00
		 3A 00 60 00
		 3A 00 47 00
		 65 00 5D 00
		 57 00 B8 00
		 75 64 61 00
		 61 00 61 08
		 60 00 60 00
		 7B 00 A1 10
		 87 10 76 00
		 DB 28 93 48
		 7D 58 78 0F
		 75 00 D8 08
		 91 20 0D 14
		 D8 03 F9 FC
		 2D 1C EF 03
		 35 05 01 23
		 D5 16 43 42
		 B4 55 40 03
		 6B 12 FB 21
		 6D 0D 51 12
		 3C 0C F5 1C
		 33 03 2F 05
		 72 03 7D 17
		 A6 23 EC 44
		 8B 53 8F 15
		 C5 22 1C E5
		 7E CA FC CD
		 F5 1C 53 B1
		 5D 06 44 BA
		 B8 17 14 83
		 B7 85 52 9A
		 9D A0 09 80
		 7C 02 F1 04
		 68 D2 AB F2
		 00 00 F9 D5
		 D1 EB FD F7
		 41 E2 62 B5
		 60 18 16 F8
		 AF DC 40 00
		 FE 05 B9 05
		 CE 07 32 00
		 87 01 BE 03
		 A6 05 09 03
		 86 02 C9 05
		 26 02 F5 02
		 4C 05 4F 00
		 37 00 43 00
		 44 64 48 00
		 4E 00 46 08
		 4A 00 47 00
		 4A 00 3E 10
		 3F 10 3D 00
		 56 28 59 48
		 66 58 72 0D
		 51 00 59 00
		 63 08 6B 00
		 4E 00 47 00
		 40 10 55 10
		 4F 00 63 20
		 7A 40 4D 58
		 5D 10 5B 00
		 55 08 3C 10
		 D8 00 DC 20
		 5F 04 78 0B
		 4E 0D A2 1C
		 B8 23 7B 45
		 9D 52 28 18
		 1C 02 A0 05
		 BC 03 6E 12
		 3F 0A 69 20
		 A6 04 6E 03
		 3D 05 B9 1C
		 35 03 D5 05
		 61 02 6B 18
		 6E 03 BD 04
		 29 02 6C 00
		 4F 21 D1 05
		 18 02 86 04
		 E7 1C 16 02
		 E1 05 5F 02
		 83 18 FB 02
		 86 05 D9 02
		 83 00 AD 00
		 C0 00 FA 00
		 0F 12 00 00
	];
};
